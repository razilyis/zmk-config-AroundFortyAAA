## config/boards/shields/around_forty_aaa/Kconfig.deconfig
```kconfig
if SHIELD_AROUND_FORTY_AAA_RIGHT

config ZMK_KEYBOARD_NAME
    string
    default "AroundFortyAAA_R"

config ZMK_SPLIT
    default y

config ZMK_SPLIT_ROLE_CENTRAL
    default y

endif

if SHIELD_AROUND_FORTY_AAA_LEFT
config ZMK_KEYBOARD_NAME
    default "AroundFortyAAA_L"

config ZMK_SPLIT
    default y

endif
```

## config/boards/shields/around_forty_aaa/Kconfig.shield
```kconfig
config SHIELD_AROUND_FORTY_AAA_RIGHT
    def_bool $(shields_list_contains,around_forty_aaa_right)

config SHIELD_AROUND_FORTY_AAA_LEFT
    def_bool $(shields_list_contains,around_forty_aaa_left) 
```
